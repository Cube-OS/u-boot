## board/cubeos/at91sam9g20isis/Kconfig
```kconfig
if TARGET_AT91SAM9G20ISIS

config SYS_BOARD
	default "at91sam9g20isis"

config SYS_VENDOR
	default "cubeos"

config SYS_CONFIG_NAME
	default "at91sam9g20isis"

config SYS_TEXT_BASE
	default 0x00000000

config SYS_LOAD_ADDR
	default 0x22000000

config AT91SAM9G20ISIS

config GENERIC_MMC

endif
```

## board/cubeos/beaglebone-black/Kconfig
```kconfig
if TARGET_BEAGLEBONE_BLACK

config SPL
	imply SPL_ENV_SUPPORT
	imply SPL_WATCHDOG_SUPPORT
	imply SPL_YMODEM_SUPPORT

config SYS_BOARD
	default "beaglebone-black"

config SYS_VENDOR
	default "cubeos"

config SYS_SOC
	default "am33xx"

config SYS_CONFIG_NAME
	default "beaglebone-black"

config CONS_INDEX
	int "UART used for console"
	range 1 6
	default 1
	help
	  The AM335x SoC has a total of 6 UARTs (UART0 to UART5 as referenced
	  in documentation, etc) available to it.  Depending on your specific
	  board you may want something other than UART0 as for example the IDK
	  uses UART3 so enter 4 here.

source "board/ti/common/Kconfig"

endif
```

## board/cubeos/pumpkin-mbm2/Kconfig
```kconfig
if TARGET_PUMPKIN_MBM2

imply SPL_ENV_SUPPORT

imply SPL_WATCHDOG_SUPPORT

imply SPL_YMODEM_SUPPORT

config SYS_BOARD
	default "pumpkin-mbm2"

config SYS_VENDOR
	default "kubos"

config SYS_SOC
	default "am33xx"

config SYS_CONFIG_NAME
	default "pumpkin-mbm2"

config CONS_INDEX
	int "UART used for console"
	range 1 6
	default 1
	help
	  The AM335x SoC has a total of 6 UARTs (UART0 to UART5 as referenced
	  in documentation, etc) available to it.  Depending on your specific
	  board you may want something other than UART0 as for example the IDK
	  uses UART3 so enter 4 here.

source "board/ti/common/Kconfig"

endif
```
